## kernel/clang_instr_profile/Kconfig
```kconfig
# SPDX-License-Identifier: GPL-2.0-only
menu "Clang's instrumentation-based kernel profiling (EXPERIMENTAL)"

config ARCH_SUPPORTS_INSTR_PROFILE_CLANG
	bool

config INSTR_PROFILE_CLANG
	bool "Enable Clang's instrumentation-based kernel profiling"
	depends on DEBUG_FS
	depends on ARCH_SUPPORTS_INSTR_PROFILE_CLANG
	depends on CC_IS_CLANG && CLANG_VERSION >= 120000
	help
	  This option enables Clang's instrumentation-based code profiling,
	  which is useful in (1) Source-based Code Coverage measurement (2)
	  profile guided kernel optimization.

	  If unsure, say N.

	  Note this option should be used together with SCC_CLANG (or PGO
	  options coming in the future) to take effect.

	  On a kernel compiled with this option, plus either coverage option or
	  PGO option, run your test suites or application workload, and download
	  the raw profile file from
	  /sys/kernel/debug/clang_instr_profile/profraw. This file needs to be
	  processed with llvm-profdata. It may be merged with other collected
	  raw profiles.

	  Copy the resulting profile file into vmlinux.profdata. It can then be
	  fed to later pipelines of generating coverage reports, or recompiling
	  the optimized kernel.

	  Note that a kernel compiled with profiling flags will be
	  significantly larger and run slower. Also be sure to exclude files
	  from profiling which are not linked to the kernel image to prevent
	  linker errors.

	  Note that the debugfs filesystem has to be mounted to access
	  profiling data.

config SCC_CLANG
	bool "Enable Clang's Source-based Code Coverage (SCC)"
	depends on INSTR_PROFILE_CLANG
	help
	  This option enables Clang's Source-based Code Coverage (SCC).

	  If unsure, say N.

	  After downloading /sys/kernel/debug/clang_instr_profile/profraw and
	  converting it into the indexed vmlinux.profdata. It can then be fed to
	  llvm-cov to generate coverage reports.

endmenu
```

## kernel/llvm-cov/Kconfig
```kconfig
# SPDX-License-Identifier: GPL-2.0-only
menu "Clang's source-based kernel coverage measurement (EXPERIMENTAL)"

config ARCH_HAS_LLVM_COV
	bool

config ARCH_HAS_LLVM_COV_PROFILE_ALL
	bool

config LLVM_COV_KERNEL
	bool "Enable Clang's source-based kernel coverage measurement"
	depends on DEBUG_FS
	depends on ARCH_HAS_LLVM_COV
	depends on CC_IS_CLANG && CLANG_VERSION >= 180000
	default n
	help
	  This option enables Clang's Source-based Code Coverage.

	  If unsure, say N.

	  On a kernel compiled with this option, run your test suites, and
	  download the raw profile from /sys/kernel/debug/llvm-cov/profraw.
	  This file can then be converted into the indexed format with
	  llvm-profdata and used to generate coverage reports with llvm-cov.

	  Additionally specify CONFIG_LLVM_COV_PROFILE_ALL=y to get profiling
	  data for the entire kernel. To enable profiling for specific files or
	  directories, add a line similar to the following to the respective
	  Makefile:

	  For a single file (e.g. main.o):
	          LLVM_COV_PROFILE_main.o := y

	  For all files in one directory:
	          LLVM_COV_PROFILE := y

	  To exclude files from being profiled even when
	  CONFIG_LLVM_COV_PROFILE_ALL is specified, use:

	          LLVM_COV_PROFILE_main.o := n
	  and:
	          LLVM_COV_PROFILE := n

	  Note that a kernel compiled with coverage flags will be significantly
	  larger and run slower.

	  Note that the debugfs filesystem has to be mounted to access the raw
	  profile.

config LLVM_COV_PROFILE_ALL
	bool "Profile entire Kernel"
	depends on !COMPILE_TEST
	depends on LLVM_COV_KERNEL
	depends on ARCH_HAS_LLVM_COV_PROFILE_ALL
	default n
	help
	  This options activates profiling for the entire kernel.

	  If unsure, say N.

	  Note that a kernel compiled with profiling flags will be significantly
	  larger and run slower.

endmenu
```
